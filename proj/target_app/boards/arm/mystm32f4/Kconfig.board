## proj/target_app/boards/arm/mystm32f4/Kconfig.board
```kconfig
# STM32F4DISCOVERY board configuration

# Copyright (c) 2016 Linaro Limited.
# SPDX-License-Identifier: Apache-2.0

config BOARD_MYSTM32F4
	bool "STM32F4DISCOVERY Development Board"
	depends on SOC_STM32F407XG
```

## proj/target_app/boards/xtensa/myesp32/Kconfig.board
```kconfig
# MYESP32 board configuration

# Copyright (c) 2017 Intel Corporation
# SPDX-License-Identifier: Apache-2.0

config BOARD_MYESP32
	bool "ESP32 Development Board"
	depends on SOC_ESP32
```
